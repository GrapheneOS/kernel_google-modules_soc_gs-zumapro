## Kconfig
```kconfig
# SPDX-License-Identifier: GPL-2.0

menuconfig DEVICE_MODULES
	bool "Support for compiling out-of-tree modules within the kernel tree"
	help
	  Say Y if you want to compile the drivers within this device-modules folder.

if DEVICE_MODULES

source "device-modules/drivers/pci/controller/dwc/Kconfig"

source "device-modules/drivers/clk/gs/Kconfig"

source "device-modules/drivers/soc/google/Kconfig"

source "device-modules/drivers/input/Kconfig"

source "device-modules/drivers/char/hw_random/Kconfig"

source "device-modules/drivers/tty/serial/Kconfig"

source "device-modules/drivers/scsi/ufs/Kconfig"

source "device-modules/drivers/i2c/busses/Kconfig"

source "device-modules/drivers/usb/host/Kconfig"

source "device-modules/drivers/usb/dwc3/Kconfig"

source "device-modules/drivers/dma/Kconfig"

source "device-modules/drivers/dma-buf/heaps/Kconfig"

source "device-modules/drivers/spi/Kconfig"

source "device-modules/drivers/pinctrl/Kconfig"

source "device-modules/drivers/trusty/Kconfig"

source "device-modules/drivers/watchdog/Kconfig"

source "device-modules/drivers/regulator/Kconfig"

source "device-modules/drivers/mfd/Kconfig"

source "device-modules/drivers/media/platform/Kconfig"

source "device-modules/drivers/clocksource/Kconfig"

source "device-modules/drivers/iommu/Kconfig"

source "device-modules/drivers/cpufreq/Kconfig"

source "device-modules/drivers/devfreq/google/Kconfig"

source "device-modules/drivers/staging/android/Kconfig"

endif # DEVICE_MODULES
```

## Kconfig.ext_modules
```kconfig
# SPDX-License-Identifier: GPL-2.0

source "$(KCONFIG_EXT_MODULES_PREFIX)private/google-modules/touch/common/Kconfig"
source "$(KCONFIG_EXT_MODULES_PREFIX)private/google-modules/touch/fts/ftm5/Kconfig"
source "$(KCONFIG_EXT_MODULES_PREFIX)private/google-modules/touch/sec/Kconfig"
source "$(KCONFIG_EXT_MODULES_PREFIX)private/google-modules/power/reset/Kconfig"
source "$(KCONFIG_EXT_MODULES_PREFIX)private/google-modules/video/gchips/Kconfig"
```

## drivers/clocksource/Kconfig
```kconfig
# SPDX-License-Identifier: GPL-2.0-only

config CLKSRC_EXYNOS_MCT_GS
	tristate "Exynos multi core timer driver in Google SoCs"
	depends on ARM || ARM64
	help
	  Support for Multi Core Timer controller in certain Google SoCs.
```

## drivers/dma-buf/heaps/Kconfig
```kconfig
# SPDX-License-Identifier: GPL-2.0

config DMABUF_HEAPS_PAGE_POOL
	tristate

source "$(KCONFIG_EXT_PREFIX)drivers/dma-buf/heaps/samsung/Kconfig"
```

## drivers/gpu/exynos/Kconfig
```kconfig
menu "Exynos Graphic Devices"
source "$(KCONFIG_EXT_PREFIX)drivers/gpu/exynos/g2d/Kconfig"
endmenu
```

## drivers/iio/Kconfig
```kconfig
# SPDX-License-Identifier: GPL-2.0-only
#
# Industrial I/O subsystem configuration
#

if IIO

source "device-modules/drivers/iio/power/Kconfig"

endif # IIO
```

## drivers/input/keyboard/Kconfig
```kconfig
# SPDX-License-Identifier: GPL-2.0-only
#
# Input core configuration

if INPUT_KEYBOARD

config KEYBOARD_S2MPG12
	tristate "Samsung Electronics S2MPG12 Powerkey Controller"
	depends on I2C
	depends on MFD_S2MPG12

endif
```

## drivers/input/misc/Kconfig
```kconfig
# SPDX-License-Identifier: GPL-2.0-only
#
# Input misc drivers configuration
#

if INPUT_MISC

source "device-modules/drivers/input/misc/vl53l1/Kconfig"

endif
```

## drivers/iommu/Kconfig
```kconfig
# SPDX-License-Identifier: GPL-2.0-only
if IOMMU_SUPPORT

config SAMSUNG_IOMMU
	tristate "Samsung IOMMU Support"
	select ARM_DMA_USE_IOMMU
	select IOMMU_DMA
	select SAMSUNG_IOMMU_GROUP
	help
	  Support for IOMMU on GS SoCs.

config SAMSUNG_IOMMU_V9
	tristate "Samsung IOMMU V9 Support"
	select ARM_DMA_USE_IOMMU
	select IOMMU_DMA
	help
	  Support for IOMMU V9 on Samsung Exynos SoCs.

config SAMSUNG_IOMMU_GROUP
	tristate "Samsung IOMMU Group Support"
	help
	  Support for IOMMU group on GS SoCs.

config SAMSUNG_SECURE_IOVA
	tristate "Samsung Secure IOVA Support"
	help
	  Support secure device virtual address management for GS SoCs.

endif # IOMMU_SUPPORT
```

## drivers/misc/Kconfig
```kconfig
# SPDX-License-Identifier: GPL-2.0-only
#
# Misc strange devices
#

config GSC_TPM
	tristate "Google Security Companion"
	depends on SPI
	help
	  Say Y here if you have a GSC security microcontroller from Google LLC
	  It will be accessible using a TPM-style transport interface from within
	  Linux.

	  To compile this driver as a module, choose M here: the
	  module will be called gsc-spi.

config GOOGLE_LOGBUFFER
	tristate "Google logbuffer"
	help
	  Say Y here to enable the logbuffer driver from Google LLC. The driver
	  exposes an API that allow drivers in GBMS and TCPM to log internal
	  and debug information that cannot be routed to syslog to a separate
	  ringbuffer. The content of the ringbuffer is accessible as a character
	  device.

	  To compile this driver as a module, choose M here: the module will be
	  called logbuffer.

config GOOGLE_VOTABLE
	tristate "Google votable interface"
	help
	  Say Y here to enable the google voter API. The module is used from
	  GBMS to arbitrate the access and manage the state of shared resources.

	  To compile this driver as a module, choose M here: the module will be
	  called gvotable.


config ACCESS_RAMOOPS
	tristate "Driver to allow access for decrypting encrypted ramoops"
	depends on PSTORE_CONSOLE
	help
	  Say 'Y' here to enable access to ramoops encryption metadata. The
	  encryption metablock contains ramoops encryption parameters.

	  To compile this driver as a module, choose M here: the module will be
	  called access_ramoops.

source "$(KCONFIG_EXT_PREFIX)drivers/misc/sscoredump/Kconfig"
source "$(KCONFIG_EXT_PREFIX)drivers/misc/sbb-mux/Kconfig"
source "$(KCONFIG_EXT_PREFIX)drivers/misc/bbdpl/Kconfig"
```

## drivers/misc/bbdpl/Kconfig
```kconfig
# SPDX-License-Identifier: GPL-2.0

config BCM_GPS_SPI_DRIVER
    tristate "BRCM GPS SPI driver"
    depends on SPI
    help
        Support for BRCM GPS SPI driver.
```

## drivers/phy/Kconfig
```kconfig
# SPDX-License-Identifier: GPL-2.0-only
#
# PHY
#

source "device-modules/drivers/phy/samsung/Kconfig"
```

## drivers/phy/samsung/Kconfig
```kconfig
# SPDX-License-Identifier: GPL-2.0-only
#
# Phy drivers for Samsung platforms
#
config PHY_EXYNOS_USBDRD
	tristate "Exynos SoC series USB DRD PHY driver"
	help
	  Enable USB DRD PHY support for Exynos SoC series.
	  This driver provides PHY interface for USB 3.0 DRD controller
	  present on Exynos SoC series.

config PHY_SAMSUNG_USB_CAL
	bool "Samsung USB PHY CAL"
	depends on PHY_EXYNOS_USBDRD
	default y
	help
	  Enable this to support CAL (Chip Abstraction Layer)
	  for Samsung USB PHY controller.
	  This driver provides PHY interface.

config PHY_SAMSUNG_USB_GEN2_V4
	tristate "Exynos SoC series USB DRD for GEN2 V4"
	default n
	help
	  Support SAMSUNG USB3.1 GEN2 V4 PHY. GEN2 V4 PHY needs
	  a different setting compared to GEN2 V2 PHY.
	  This driver provides PHY interface for USB3.1 GEN2 V4 PHY.

config PHY_EXYNOS_MIPI
	tristate "Samsung EXYNOS SoC MIPI CSI/DSI D/C-PHY driver"
	select GENERIC_PHY
	help
	  Support for MIPI CSI and MIPI DSI DPHY found on Samsung
	  and EXYNOS SoCs.

config PHY_EXYNOS_MIPI_DSIM
	tristate "Samsung EXYNOS SoC MIPI DSI D-PHY driver"
	select GENERIC_PHY
	help
	  Support for MIPI DSI DPHY found on Samsung
	  and EXYNOS SoCs.
```

## drivers/power/Kconfig
```kconfig
# SPDX-License-Identifier: GPL-2.0-only
source "device-modules/drivers/power/reset/Kconfig"
```

## drivers/pwm/Kconfig
```kconfig
# SPDX-License-Identifier: GPL-2.0-only

if PWM

config PWM_SAMSUNG
	tristate "Samsung PWM support"
	depends on PLAT_SAMSUNG || || SOC_ZUMA || ARCH_EXYNOS || COMPILE_TEST
	depends on HAS_IOMEM
	help
	  Generic PWM framework driver for Samsung.
	  To compile this driver as a module, choose M here: the module
	  will be called pwm-samsung.

endif
```

## drivers/regulator/Kconfig
```kconfig
# SPDX-License-Identifier: GPL-2.0-only

if REGULATOR

config REGULATOR_MAX77826_GS
	tristate "GS-specific Maxim MAX77826 regulator"
	help
	  If you say yes here you get support for Maxim MAX77826 PMIC.

config DRV_SAMSUNG_PMIC
	tristate "Samsung PMIC sysfs system"
	depends on MFD_S2MPG10 || MFD_S2MPG11
	help
	  This driver supports a Samsung PMIC sysfs.
	  The sysfs directory made by this config includes directories of
	  regulator and powermeter of S2MPG10 and S2MPG11.
	  They provide Speedy read and write function through for debugging.

config REGULATOR_S2MPG10
	tristate "Samsung S2MPG10 voltage regulator"
	depends on MFD_S2MPG10
	help
	  This driver supports a Samsung S2MPG10 voltage output regulator
	  via speedy bus. S2MPG10 is comprised of high efficient Buck converters
	  including Dual-Phase Buck converter, Buck-Boost converter and
	  various LDOs. This driver file includes functions for reading and
	  writing output voltage, controlling operation mode, setting ramp
	  rate of each regulator.

config REGULATOR_S2MPG11
	tristate "Samsung S2MPG11 voltage regulator"
	depends on MFD_S2MPG11
	help
	  This driver supports a Samsung S2MPG11 voltage output regulator
	  via I2C bus. S2MPG11 is comprised of high efficient Buck converters
	  including Dual-Phase Buck converter, Buck-Boost converter and
	  various LDOs. This driver file includes functions for reading and
	  writing output voltage, controlling operation mode, setting ramp
	  rate of each regulator.

config POWERMETER_S2MPG10
	tristate "Samsung S2MPG10 Powermeter"
	depends on MFD_S2MPG10
	help
	  This driver supports a Samsung S2MPG10 powermeter which has 8 ADC
	  channels for saving current and voltage data of each regulator.
	  The sysfs files in the sysfs directory created by the config
	  DRV_SAMSUNG_PMIC is are made by this driver for debugging.

config POWERMETER_S2MPG11
	tristate "Samsung S2MPG11 Powermeter"
	depends on MFD_S2MPG11
	help
	  This driver supports a Samsung S2MPG11 powermeter which has 8 ADC
	  channels for saving current and voltage data of each regulator.
	  The sysfs files in the sysfs directory created by the config
	  DRV_SAMSUNG_PMIC is are made by this driver for debugging.

config REGULATOR_SLG51000_GS
	tristate "Dialog Semiconductor SLG51000 regulators for some GS SoCs"
	depends on I2C
	select REGMAP_I2C
	help
	  Say y here to support for the Dialog Semiconductor SLG51000 for GS
	  SOCs. The SLG51000 is seven compact and customizable low dropout
	  regulators.

endif
```

## drivers/soc/google/gsa/Kconfig
```kconfig
# SPDX-License-Identifier: GPL-2.0

config GSA
	tristate "GSA driver"
	default n

config GSA_GSC
	tristate "GSC Proxy"
	depends on GSA
	default n
```

## drivers/soc/google/vh/kernel/sched/Kconfig
```kconfig
# SPDX-License-Identifier: GPL-2.0-only

config VH_SCHED
	tristate "Vendor hooks for kernel scheduler"
	depends on VH_KERNEL
	default n

config VH_SCHED_CPU_NR
	int "CPU number on this platform"
	depends on VH_SCHED
	default 8

config VH_MIN_CAPACITY_CPU
	int "Starting cpu of min capacity cluster"
	depends on VH_SCHED
	default 0

config VH_MID_CAPACITY_CPU
	int "Starting cpu of mid capacity cluster"
	depends on VH_SCHED
	default 4

config VH_MAX_CAPACITY_CPU
	int "Starting cpu of max capacity cluster"
	depends on VH_SCHED
	default 6

config VH_HIGH_CAPACITY_CPU
	int "Starting cpu of high capacity cluster"
	depends on VH_SCHED
	default 4

config VH_PREEMPTIRQ_TRACEPOINTS
	tristate "Vendor hooks for long preemptirq trace points"
	depends on VH_SCHED
	default n

config UCLAMP_STATS
	bool "Uclamp stats"
	depends on VH_SCHED
	default n

config USE_VENDOR_GROUP_UTIL
        bool "Use cpu util based on vendor groups"
        depends on VH_SCHED
        default y

config USE_GROUP_THROTTLE
	bool "Use group throttle of vendor groups"
	depends on VH_SCHED
	default y

config VH_SCHED_LIB
	bool "Library with additional scheduler options"
	depends on VH_SCHED
	default n
```

## drivers/thermal-whi/Kconfig
```kconfig
# SPDX-License-Identifier: GPL-2.0-only
#
# Generic thermal drivers configuration
#

if THERMAL

menu "Samsung thermal drivers"
depends on (ARCH_EXYNOS || SOC_GOOGLE) || COMPILE_TEST
source "$(KCONFIG_EXT_PREFIX)drivers/thermal-whi/samsung/Kconfig"
source "$(KCONFIG_EXT_PREFIX)drivers/thermal-whi/google/Kconfig"
endmenu

endif
```

## drivers/thermal/Kconfig
```kconfig
# SPDX-License-Identifier: GPL-2.0-only
#
# Generic thermal drivers configuration
#

if THERMAL

menu "Samsung thermal drivers"
depends on (ARCH_EXYNOS || SOC_GOOGLE) || COMPILE_TEST
source "device-modules/drivers/thermal/samsung/Kconfig"
source "device-modules/drivers/thermal/google/Kconfig"
endmenu

endif
```

## drivers/thermal/google/Kconfig
```kconfig
# SPDX-License-Identifier: GPL-2.0-only

config GSOC_PMIC_THERMAL
	tristate "Google LLC. Granville SPMIC thermal driver"
	depends on THERMAL
	help
	  This enables the thermal driver for the Granville PMIC adc thermistors
	  device. It registers thermal zone with multiple trip points.
	  Thermal client sets threshold temperature and  gets updated when
	  a threshold is reached.

config GSOC_PMIC_THERMAL_CAMBRIA
	tristate "Google LLC. Cambria SPMIC thermal driver"
	depends on THERMAL
	help
	  This enables the thermal driver for the Cambria PMIC adc thermistors
	  device. It registers thermal zone with multiple trip points.
	  Thermal client sets threshold temperature and  gets updated when
	  a threshold is reached.
```

## drivers/usb/Kconfig
```kconfig
# SPDX-License-Identifier: GPL-2.0
#
# USB device configuration
#

if USB_SUPPORT

if USB

source "device-modules/drivers/usb/host/Kconfig"

endif

source "device-modules/drivers/usb/dwc3/Kconfig"

source "device-modules/drivers/usb/gadget/Kconfig"

source "device-modules/drivers/usb/typec/Kconfig"

endif # USB_SUPPORT
```

## drivers/usb/typec/Kconfig
```kconfig
# SPDX-License-Identifier: GPL-2.0

if TYPEC

source "device-modules/drivers/usb/typec/tcpm/Kconfig"

endif # TYPEC
```

## drivers/video/Kconfig
```kconfig
# SPDX-License-Identifier: GPL-2.0-only
#
# Video configuration
#

if HAS_IOMEM

source "device-modules/drivers/gpu/exynos/Kconfig"

endif
```
