// SPDX-License-Identifier: GPL-2.0-only
/*
 * ZUMA Mali GPU  device tree source
 *
 * Copyright 2022 Google LLC
 *
 */
/ {
	mali: mali@1F000000 {
		compatible = "arm,malit6xx";
		reg = <0x0 0x1F000000 0x1000000>;
		l2-hash-values = <0x0036DB6D 0x005B6DB6 0x0>;
		interrupts =
			<GIC_SPI IRQ_G3D_IRQJOB_G3D IRQ_TYPE_LEVEL_HIGH>,
			<GIC_SPI IRQ_G3D_IRQMMU_G3D IRQ_TYPE_LEVEL_HIGH>,
			<GIC_SPI IRQ_G3D_IRQGPU_G3D IRQ_TYPE_LEVEL_HIGH>;
		interrupt-names = "JOB", "MMU", "GPU";
		/* Power */
		power-domains = <&pd_g3d>, <&pd_embedded_g3d>;

		/* Thermal */
		#cooling-cells = <2>;
		gpu_power_coeff = <625>;
		ect-coeff-index = <3>;
	};
};
