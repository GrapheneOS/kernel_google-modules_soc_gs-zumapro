// SPDX-License-Identifier: GPL-2.0-only
/*
 * USB device tree source code for Zuma Pro SoC
 *
 * Copyright 2023 Google LLC.
 */
#include "zuma-usb.dtsi"
&udc {
	/delete-property/  power-domains;
	/delete-property/  s2mpus;
};

&usbdrd_phy0 {
	/delete-property/  power-domains;
	/delete-property/  s2mpus;
};
