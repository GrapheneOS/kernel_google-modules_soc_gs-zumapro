// SPDX-License-Identifier: GPL-2.0-only
/*
 * Goodix fps device tree source
 *
 * Copyright 2022 Google,LLC.
 */

&odm {
	goodixfp: goodixfp {
		status = "okay";
		compatible = "goodix,fingerprint";
		interrupt-parent = <&gpa7>;
		interrupts = <3 0>;
		spi-max-frequency = <1000000>;
		pinctrl-names = "default";
		fp-gpio-irq = <&gpa7 3 GPIO_ACTIVE_HIGH>;
		fp-gpio-reset = <&gpp1 0 GPIO_ACTIVE_LOW>;
	};
};

&s_ldo15_reg {
	regulator-always-on;
	regulator-min-microvolt = <3300000>;
	regulator-max-microvolt = <3300000>;
};

