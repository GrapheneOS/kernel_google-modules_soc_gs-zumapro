// SPDX-License-Identifier: GPL-2.0-only
/*
 * USB device tree source code for Zuma SoC
 *
 * Copyright 2022 Google LLC.
 */

&udc {
	extcon = <&max77759tcpc>;
};

&usbdrd_phy0 {
	extcon = <&max77759tcpc>;
};
