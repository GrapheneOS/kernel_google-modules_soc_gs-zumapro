// SPDX-License-Identifier: GPL-2.0-only
/*
 * Charge Pump config for ln8411.
 * Intended to be included into the approriate I2C bus.
 *
 * Copyright 2023 Google LLC
 */

ln8411_dc: ln8411@6e {
	compatible = "ln8411";
	reg = <0x6e>;

	ln8411,psy_name = "dc-mains";

	ln8411,input-itopoff = <500000>; /* 500mA */

	/* USBC thermal zone */
	google,usb-port-tz-name = "usbc-therm-adc";

	ln8411,google_cpm = <&google_cpm>;
	ln8411,input-current-limit = <3000000>;

	status = "disabled";

	ln8411_gpio: ln8411_gpio {
		gpio-controller;
		#gpio-cells = <2>;
		ngpios = <1>;
	};
};

pca9468_dc: pca9468@57 {
	compatible = "nxp,pca9468";
	reg = <0x57>;
	status = "okay";

	pca9468,psy_name = "dc-mains";

	pinctrl-names = "default";
	pinctrl-0 = <&dc_charger_irq>;

	interrupt-parent = <&gpa7>;
	pca9468,irq-gpio = <&gpa7 4 GPIO_ACTIVE_LOW>; /* PLC_INT_L */

	pca9468,float-voltage = <4300000>; /* 4.3V */

	pca9468,input-itopoff = <500000>; /* 500mA */
	pca9468,sense-resistance = <0>; /* 5mOhm */
	pca9468,switching-frequency = <3>; /* 980KHz */

	/* disable USBC NTC */
	pca9468,ntc-threshold = <0>; /* disabled */

	/* USBC thermal zone */
	google,usb-port-tz-name = "usbc-therm-adc";

	/* irdrop */
	google,irdrop-limits = <105000 75000 0>;

	pca9468,google_cpm = <&google_cpm>;
};
